## Firmware/boards/arm/cyclowatt/Kconfig.board
```kconfig
# Copyright (c) 2024 Nordic Semiconductor ASA
# SPDX-License-Identifier: Apache-2.0

config BOARD_CYCLOWATT
	bool "cyclowatt-pinctrl"
	depends on SOC_NRF52811_QFAA
```

## Firmware/boards/arm/cyclowatt/Kconfig.defconfig
```kconfig
# Copyright (c) 2024 Nordic Semiconductor ASA
# SPDX-License-Identifier: Apache-2.0

if BOARD_CYCLOWATT

config BOARD
	default "cyclowatt"

config BT_CTLR
   default BT


endif
```
